## config/west.yml
```yaml
manifest:
  defaults:
    revision: main
  remotes:
    - name: zmkfirmware
      url-base: https://github.com/zmkfirmware
    - name: paulshir
      url-base: https://github.com/paulshir
    - name: urob
      url-base: https://github.com/urob
  projects:
    - name: zmk
      remote: zmkfirmware
      import: app/west.yml
    - name: zmk-board-iris-ce
      remote: paulshir
    - name: zmk-behaviors-dev
      remote: paulshir
    - name: zmk-auto-layer
      remote: urob
    - name: zmk-tri-state
      remote: urob
  self:
    path: config
```
